/*
 * Copyright (c) 2020 Pete Johanson, Richard Jones
 *
 * SPDX-License-Identifier: MIT
 */

#include <behaviors.dtsi>
#include <dt-bindings/zmk/keys.h>
#include <dt-bindings/zmk/bt.h>
#include <dt-bindings/zmk/outputs.h>

/ {
    keymap {
        compatible = "zmk,keymap";
        
        default_layer {
            label = "Test";
            bindings = <
	    &out OUT_TOG &bt BT_CLR
	    /*
	    &out OUT_TOG &bt BT_CLR &kp LS(NUM_1)
	    */
	    >;
        };
    };
};


