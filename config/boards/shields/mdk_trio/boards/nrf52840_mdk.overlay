&i2c0 {
	status = "disabled";
};

&spi0 {
	status = "okay";
	compatible = "nordic,nrf-spi";
	sck-pin = <17>;
	mosi-pin = <21>;
	miso-pin = <12>;

	cs-gpios = <&gpio0 16 GPIO_ACTIVE_LOW>;

	ssd16xxfb@0 {
		compatible = "gooddisplay,il0323";
		label = "DISPLAY";
		spi-max-frequency = <4000000>;
		reg = <0>;
		width = <80>;
		height = <128>;
		dc-gpios = <&gpio0 15 GPIO_ACTIVE_LOW>;	/* D9 */
		reset-gpios = <&gpio0 14 GPIO_ACTIVE_LOW>;	/* D8 */
		busy-gpios = <&gpio0 13 GPIO_ACTIVE_LOW>;	/* D7 */
		cdi = <0xd2>;
		tcon = <0x22>;
		pwr = [03 00 26 26];
	};
//	ssd16xxfb@0 {
//		compatible = "solomon,ssd16xxfb", "gooddisplay,gdeh0213b1";
//		label = "DISPLAY";
//		spi-max-frequency = <4000000>;
//		reg = <0>;
//		width = <200>;
//		height = <200>;
//		pp-width-bits = <16>;
//		pp-height-bits = <16>;
//		dc-gpios = <&gpioa 3 GPIO_ACTIVE_LOW>;	/* D9 */
//		reset-gpios = <&gpioc 6 GPIO_ACTIVE_LOW>;	/* D8 */
//		busy-gpios = <&gpioa 2 GPIO_ACTIVE_HIGH>;	/* D7 */
//		gdv = [17];
//		sdv = [41 a8 32];
//		vcom = <0x28>;
//		border-waveform = <0x05>;
//		lut-initial = [
//			40 00 00 00 00 00 00 00 00 00 00 00
//			80 00 00 00 00 00 00 00 00 00 00 00
//			40 00 00 00 00 00 00 00 00 00 00 00
//			80 00 00 00 00 00 00 00 00 00 00 00
//			00 00 00 00 00 00 00 00 00 00 00 00
//			0A 00 00 00 00 00 00
//			00 00 00 00 00 00 00
//			00 00 00 00 00 00 00
//			00 00 00 00 00 00 00
//			00 00 00 00 00 00 00
//			00 00 00 00 00 00 00
//			00 00 00 00 00 00 00
//			00 00 00 00 00 00 00
//			00 00 00 00 00 00 00
//			00 00 00 00 00 00 00
//			00 00 00 00 00 00 00
//			00 00 00 00 00 00 00
//			22 22 22 22 22 22
//			00 00 00
//			22 17 41 A8 32 08
//		];
//		lut-default = [
//			40 00 00 00 00 00 00 00 00 00 00 00
//			80 00 00 00 00 00 00 00 00 00 00 00
//			40 00 00 00 00 00 00 00 00 00 00 00
//			80 00 00 00 00 00 00 00 00 00 00 00
//			00 00 00 00 00 00 00 00 00 00 00 00
//			0A 00 00 00 00 00 00
//			00 00 00 00 00 00 00
//			00 00 00 00 00 00 00
//			00 00 00 00 00 00 00
//			00 00 00 00 00 00 00
//			00 00 00 00 00 00 00
//			00 00 00 00 00 00 00
//			00 00 00 00 00 00 00
//			00 00 00 00 00 00 00
//			00 00 00 00 00 00 00
//			00 00 00 00 00 00 00
//			00 00 00 00 00 00 00
//			22 22 22 22 22 22
//			00 00 00
//			22 17 41 A8 32 08
//		];
//	};
};
