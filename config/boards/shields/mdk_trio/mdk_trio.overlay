/*
 * Copyright (c) 2020 Pete Johanson, Richard Jones
 *
 * SPDX-License-Identifier: MIT
 */

#include <dt-bindings/zmk/matrix_transform.h>

/ {
	chosen {
		zmk,kscan = &kscan0;
	};

	kscan0: kscan {
		compatible = "zmk,kscan-gpio-direct";
		label = "KSCAN";

		input-gpios
			= <&gpio0 26 (GPIO_ACTIVE_LOW | GPIO_PULL_UP)>
			, <&gpio0 25 (GPIO_ACTIVE_LOW | GPIO_PULL_UP)>
			;
	};
};

