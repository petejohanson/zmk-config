/*
 * Copyright (c) 2020 Pete Johanson, Richard Jones
 *
 * SPDX-License-Identifier: MIT
 */

#include <dt-bindings/zmk/matrix-transform.h>

/ {
	chosen {
		zmk,kscan = &kscan0;
	};

	kscan0: kscan {
		compatible = "zmk,kscan-gpio-direct";
		label = "KSCAN";

		input-gpios
			= <&arduino_header 6 (GPIO_ACTIVE_LOW | GPIO_PULL_UP)>
			, <&arduino_header 7 (GPIO_ACTIVE_LOW | GPIO_PULL_UP)>
			, <&arduino_header 8 (GPIO_ACTIVE_LOW | GPIO_PULL_UP)>
			;
	};
};

