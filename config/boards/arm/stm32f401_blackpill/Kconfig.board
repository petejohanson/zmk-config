## config/boards/arm/stm32f401_blackpill/Kconfig.board
```kconfig
# STM32F401 BlackPill board configuration

# Copyright (c) 2021 Peter Johansons
# SPDX-License-Identifier: Apache-2.0

config BOARD_STM32F401_BLACKPILL
	bool "STM32F401 BlackPill Development Board"
	depends on SOC_STM32F401CC
```

## config/boards/arm/stm32f401_blackpill/Kconfig.defconfig
```kconfig
# STM32F401 BlackPill board configuration

# Copyright (c) 2021 Pete Johanson
# SPDX-License-Identifier: Apache-2.0

if BOARD_STM32F401_BLACKPILL

config BOARD
	default "stm32f401_blackpill"

endif # BOARD_STM32F401_BLACKPILL
```

## config/boards/arm/stm32f401_blackpill/stm32f401_blackpill_defconfig
```kconfig
# SPDX-License-Identifier: Apache-2.0

CONFIG_SOC_SERIES_STM32F4X=y
CONFIG_SOC_STM32F401XC=y
# 168MHz system clock
CONFIG_SYS_CLOCK_HW_CYCLES_PER_SEC=48000000

# Enable MPU
CONFIG_ARM_MPU=y

# enable pinmux
CONFIG_PINMUX=y

# enable GPIO
CONFIG_GPIO=y

# Use Code partition!
CONFIG_USE_DT_CODE_PARTITION=y

# clock configuration
CONFIG_CLOCK_CONTROL=y

# Clock configuration for Cube Clock control driver
CONFIG_CLOCK_STM32_HSE_CLOCK=25000000
CONFIG_CLOCK_STM32_SYSCLK_SRC_PLL=y
# use HSE as PLL input
CONFIG_CLOCK_STM32_PLL_SRC_HSE=y
# produce 168MHz clock at PLL output
CONFIG_CLOCK_STM32_PLL_M_DIVISOR=25
CONFIG_CLOCK_STM32_PLL_N_MULTIPLIER=336
CONFIG_CLOCK_STM32_PLL_P_DIVISOR=4
CONFIG_CLOCK_STM32_PLL_Q_DIVISOR=7
CONFIG_CLOCK_STM32_AHB_PRESCALER=1
CONFIG_CLOCK_STM32_APB1_PRESCALER=2
CONFIG_CLOCK_STM32_APB2_PRESCALER=1
```

## config/boards/shields/mdk_trio/Kconfig.defconfig
```kconfig
# Copyright (c) 2020 Pete Johanson, Richard Jones
# SPDX-License-Identifier: MIT

if SHIELD_MDK_TRIO

config ZMK_KEYBOARD_NAME
	default "MDK Trio"

endif
```

## config/boards/shields/mdk_trio/boards/nrf52840_mdk.conf
```kconfig
CONFIG_LVGL_HOR_RES_MAX=80
CONFIG_LVGL_VER_RES_MAX=128
CONFIG_SPI=y
CONFIG_IL0323=y
CONFIG_LVGL_BITS_PER_PIXEL=1
CONFIG_LVGL_COLOR_DEPTH_1=y
CONFIG_LVGL_DPI=145
CONFIG_LVGL_VDB_SIZE=100
CONFIG_LVGL_USE_THEME_MONO=y
```

## config/boards/shields/nano_oled/Kconfig.shield
```kconfig
# Copyright (c) 2020 Pete Johanson
# SPDX-License-Identifier: MIT

config SHIELD_NANO_OLED
	def_bool $(shields_list_contains,nano_oled)
```

## config/boards/shields/uno_trio/Kconfig.defconfig
```kconfig
# Copyright (c) 2020 Pete Johanson, Richard Jones
# SPDX-License-Identifier: MIT

if SHIELD_UNO_TRIO

config ZMK_KEYBOARD_NAME
	default "Uno Trio"

endif
```

## config/boards/shields/uno_trio/Kconfig.shield
```kconfig
# Copyright (c) 2020 Pete Johanson, Richard Jones
# SPDX-License-Identifier: MIT

config SHIELD_UNO_TRIO
	def_bool $(shields_list_contains,uno_trio)
```

## config/west.yml
```yaml
manifest:
  remotes:
    - name: zmkfirmware
      url-base: https://github.com/zmkfirmware
    - name: petejohanson
      url-base: https://github.com/petejohanson
  projects:
    - name: zmk
      remote: petejohanson
      revision: core/modular-build-exploration
      import: app/west.yml
  self:
    path: config
```
